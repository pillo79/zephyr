## boards/arduino/nano_esp32/Kconfig.arduino_nano_esp32
```kconfig
# Copyright (c) 2025 Arduino SA
# SPDX-License-Identifier: Apache-2.0

config BOARD_ARDUINO_NANO_ESP32
	select SOC_ESP32S3_WROOM_N8
	select SOC_ESP32S3_PROCPU if BOARD_ARDUINO_NANO_ESP32_ESP32S3_PROCPU
	select SOC_ESP32S3_APPCPU if BOARD_ARDUINO_NANO_ESP32_ESP32S3_APPCPU
```

## dts/bindings/gpio/arduino-due-header.yaml
```yaml
# Copyright (c) 2025 Arduino SA
# SPDX-License-Identifier: Apache-2.0

description: |
    GPIO pins exposed on Arduino DUE and Arduino MEGA headers.

    The Arduino DUE layout extends the Arduino UNO layout from the bottom,
    with two very long vertical headers plus a double-row horizontal header.
    It is designed to keep mechanical compatibility with the Arduino UNO
    layout, while adding more GPIO pins.
    
    The vertical headers have this numbering:

                                 SCL  xxx
                                 SDA  xxx
                                 AREF -
                                 GND  -
        - N/C                    D13  13
        - IOREF                  D12  12
        - RESET                  D11  11
        - 3V3                    D10  10
        - 5V                     D9    9
        - GND                    D8    8
        - GND
        - VIN                    D7    7
                                 D6    6
       54 A0                     D5    5
       55 A1                     D4    4
       56 A2                     D3    3
       57 A3                     D2    2
       58 A4                     D1    1
       59 A5                     D0    0
       60 A6                     
       61 A7                     D14  14
                                 D15  15
       62 A8                     D16  16
       63 A9                     D17  17
       64 A10                    D18  18
       65 A11                    D19  19
       66 DAC2                   D20  20
       67 DAC1                   D21  21
       68 D68
       69 D69

    The horizontal header below those, when rotated counter-clockwise so that
    the right side is closer to the edge of the board, has this numbering:

               - +5V     +5V -
              22 D22     D23 23
              24 D24     D25 25
              26 D26     D27 27
              28 D28     D29 29
              30 D30     D31 31
              32 D32     D33 33
              34 D34     D35 35
              36 D36     D37 37
              38 D38     D39 39
              40 D40     D41 41
              42 D42     D43 43
              44 D44     D45 45
              46 D46     D47 47
              48 D48     D49 49
              50 D50     D51 51
              52 D52     D53 53
               - GND     GND -

compatible: "arduino-due-header"

include: [gpio-nexus.yaml, base.yaml]
```

## dts/bindings/gpio/arduino-giga-header.yaml
```yaml
# Copyright (c) 2019 Foundries.io
# Copyright (C) 2019 Peter Bigot Consulting, LLC
# Copyright (c) 2025 Arduino SA
# SPDX-License-Identifier: Apache-2.0

description: |
    GPIO pins exposed on Arduino Uno (R3) headers.

    The Arduino Uno layout provides four headers, two each along
    opposite edges of the board.

    Proceeding counter-clockwise:
    * An 8-pin Power Supply header.  No pins on this header are exposed
      by this binding.
    * A 6-pin Analog Input header.  This has analog input signals
      labeled from A0 at the top through A5 at the bottom.
    * An 8-pin header (opposite Analog Input).  This has digital input
      signals labeled from D0 at the bottom D7 at the top;
    * A 10-pin header (opposite Power Supply).  This has six additional
      digital input signals labelled from D8 at the bottom through D13
      towards the top, skipping two pins, then finishing with D14 and
      D15 at the top.

    This binding provides a nexus mapping for 20 pins where parent pins 0
    through 15 correspond to D0 through D15, and parent pins 16 through 21
    correspond to A0 through A5, as depicted below:

                                 D15  15
                                 D14  14
                                 AREF -
                                 GND  -
        - N/C                    D13  13
        - IOREF                  D12  12
        - RESET                  D11  11
        - 3V3                    D10  10
        - 5V                     D9    9
        - GND                    D8    8
        - GND
        - VIN                    D7    7
                                 D6    6
       16 A0                     D5    5
       17 A1                     D4    4
       18 A2                     D3    3
       19 A3                     D2    2
       20 A4                     D1    1
       21 A5                     D0    0

    This binding provides a pin numbering that is compatible with the one used
    in Arduino sketches.

compatible: "arduino-uno-r3-header"

include: [gpio-nexus.yaml, base.yaml]
```

## dts/bindings/gpio/arduino-header-r3.yaml
```yaml
# Copyright (c) 2019 Foundries.io
# Copyright (C) 2019 Peter Bigot Consulting, LLC
# SPDX-License-Identifier: Apache-2.0

description: |
    GPIO pins exposed on Arduino Uno (R3) headers using the legacy
    numbering scheme. Deprecated in favor of the "arduino-uno-r3-header"
    binding that is fully Arduino compatible.

    The Arduino Uno layout provides four headers, two each along
    opposite edges of the board.

    Proceeding counter-clockwise:
    * An 8-pin Power Supply header.  No pins on this header are exposed
      by this binding.
    * A 6-pin Analog Input header.  This has analog input signals
      labeled from A0 at the top through A5 at the bottom.
    * An 8-pin header (opposite Analog Input).  This has digital input
      signals labeled from D0 at the bottom D7 at the top;
    * A 10-pin header (opposite Power Supply).  This has six additional
      digital input signals labelled from D8 at the bottom through D13
      towards the top, skipping two pins, then finishing with D14 and
      D15 at the top.

    This binding provides a nexus mapping for 20 pins where parent pins 0
    through 5 correspond to A0 through A5, and parent pins 6 through 21
    correspond to D0 through D15.

    This sequence is different with the one used in Arduino sketches, which
    starts with the digital pins. The "arduino-uno-r3-header" binding provides
    a mapping that is compatible with the Arduino numbering and should be used
    instead.


compatible: "arduino-header-r3"

include: [gpio-nexus.yaml, base.yaml]
```

## tests/cmake/snippets/Kconfig
```kconfig
# Copyright 2023 Nordic Semiconductor ASA
# SPDX-License-Identifier: Apache-2.0

mainmenu "Snippet tests"

menu "Zephyr"
source "Kconfig.zephyr"
endmenu

# Snippet test types used by the test implementation to steer the test logic
choice
	prompt "Snippet Test Type"
	default TEST_TYPE_NONE

config TEST_TYPE_NONE
	bool "Test Type: None"
	help
	  Test the initial state with no snippets applied.

config TEST_TYPE_FOO
	bool "Test Type: Foo"
	help
	  Test the `foo` snippet from the default application snippet root.

config TEST_TYPE_BAR
	bool "Test Type: Bar"
	help
	  Test the `bar` snippet from an extra snippet root.

config TEST_TYPE_FOO_BAR
	bool "Test Type: Foo-Bar"
	help
	  Test the snippet processing order (1. foo, 2. bar)

config TEST_TYPE_BAR_FOO
	bool "Test Type: Bar-Foo"
	help
	  Test the snippet processing order (1. bar, 2. foo)

config TEST_TYPE_VER_CHECK
	bool "Test Type: Version check"
	help
	  Test board version snippet application

config TEST_TYPE_VER_CHECK_SPECIFIC
	bool "Test Type: Version check specific"
	help
	  Test board version snippet application with specific board version

config TEST_TYPE_VER_CHECK_SPECIFIC_SHIELD
	bool "Test Type: Version check specific with shield"
	help
	  Test board version snippet application with a specific board version
	  and a shield

config TEST_TYPE_FILE_LIST
	bool "Test Type: File list"
	help
	  Test list support for snippet conf and overlay files.

endchoice

# Test values set by the snippet config overlays and tested by the test logic
config TEST_FOO_VAL
	int "Test value set by the 'foo' snippet config overlay"
	help
	  This option's value should be overridden by the 'foo' snippet config
	  overlay.

config TEST_BAR_VAL
	int "Test value set by the 'bar' snippet config overlay"
	help
	  This option's value should be overridden by the 'bar' snippet config
	  overlay.

config TEST_COMMON_VAL
	int "Test value set by the snippet config overlays"
	help
	  This option's value should be overridden by the snippet config
	  overlays.

# Set by the 'shield_check' snippet, to test shield-specific snippet settings
config TEST_SHIELD_COMMON_APPLIED
	bool "Test shield check snippet applied"
	help
	  Set by the common part of the 'shield_check' snippet.

config TEST_SHIELD_ONE_APPLIED
	bool "Test shield-specific snippet applied"
	help
	  Set by the 'shield_check' snippet section for shield
	  'snippet_shield_one'.

config TEST_SHIELD_REGEX_APPLIED
	bool "Test shield regular expression snippet applied"
	help
	  Set by the 'shield_check' snippet section matching all the
	  'snippet_shield_*' shields.

config TEST_SHIELD_NEVER_APPLIED
	bool "Test snippet section for a shield which is never used"
	help
	  Set by the 'shield_check' snippet section for a shield which does not
	  exist, and must therefore never end up in the build.

# Set by the 'board_shield_check' snippet, to test shield sections nested
# inside a board section
config TEST_BOARD_SHIELD_COMMON_APPLIED
	bool "Test board section of the board_shield_check snippet applied"

config TEST_BOARD_SHIELD_ONE_APPLIED
	bool "Test board + 'snippet_shield_one' section applied"

config TEST_BOARD_SHIELD_REGEX_APPLIED
	bool "Test board + shield regular expression section applied"

config TEST_BOARD_ONLY_SHIELD_TWO_APPLIED
	bool "Test section of a board which only has a nested shield applied"

# Set by the snippet section which is expected to win when a board section and
# a shield section both set it
config TEST_PRECEDENCE_VAL
	int "Test value set by several competing snippet sections"
	default 0

# Set from tests.yaml, to tell the test which sections it should see
config TEST_EXPECT_PRECEDENCE_VAL
	int "Expected value of TEST_PRECEDENCE_VAL"
	default 0

config TEST_EXPECT_SHIELD_COMMON
	bool "Expect the common 'shield_check' settings"

config TEST_EXPECT_SHIELD_ONE
	bool "Expect the 'snippet_shield_one' settings"

config TEST_EXPECT_SHIELD_REGEX
	bool "Expect the shield regular expression settings"

config TEST_EXPECT_BOARD_SHIELD_COMMON
	bool "Expect the 'board_shield_check' board settings"

config TEST_EXPECT_BOARD_SHIELD_ONE
	bool "Expect the board + 'snippet_shield_one' settings"

config TEST_EXPECT_BOARD_SHIELD_REGEX
	bool "Expect the board + shield regular expression settings"

config TEST_EXPECT_BOARD_ONLY_SHIELD_TWO
	bool "Expect the settings of the board which only has a nested shield"

# Used for testing board version snippets
config TEST_VER_CHECK_APPLIED
	bool "Test version check snippet applied"
	help
	  This option's value should be set by the ver_check snippet.

config TEST_VER_CHECK_SPECIFIC_VERSION_APPLIED
	bool "Test version check with board version snippet applied"
	help
	  This option's value should be set by the ver_check snippet.

config TEST_VER_CHECK_SPECIFIC_SHIELD_APPLIED
	bool "Test version check with board version and shield snippet applied"
	help
	  This option's value should be set by the ver_check snippet section for
	  a shield nested inside a board revision.

# Used for testing board file list variables
config TEST_BOARD1
	bool "Test value set by the snippet file list board 1 config overlay"
	help
	  This option's value should be overridden by the snippet config
	  overlays.

config TEST_BOARD2
	bool "Test value set by the snippet file list board 2 config overlay"
	help
	  This option's value should be overridden by the snippet config
	  overlays.
```
