## drivers/regulator/Kconfig.bq25120a
```kconfig
# Copyright (c) 2024 Arduino SA
# SPDX -License-Identifier: Apache-2.0

config REGULATOR_BQ25120A
	bool "BQ25120A PMIC regulator driver"
	default y
	depends on DT_HAS_TI_BQ25120A_REGULATOR_ENABLED
	select I2C
	help
	  Enable the Texas Instruments BQ25120A regulator driver.

config REGULATOR_BQ25120A_INIT_PRIORITY
	int "BQ25120A regulator driver init priority"
	default 76
	depends on REGULATOR_BQ25120A
	help
	  Init priority for the Texas Instruments BQ25120A regulator driver.
```

## drivers/sensor/bhy2/Kconfig
```kconfig
# BMY2 temperature, pressure, humidity and gas sensor configuration options

# Copyright (c) 2018 Bosch Sensortec GmbH
# Copyright (c) 2022, Leonard Pollak
#
# SPDX-License-Identifier: Apache-2.0

menuconfig BHY2
	bool "BHY2 sensor"
	default y
	depends on DT_HAS_BOSCH_BHY2_ENABLED
	select I2C
	help
	  Enable driver for BHY2 sensor fusion IC.
```

## dts/bindings/mfd/ti,bq25120a.yaml
```yaml
# Copyright (c) 2024 Arduino SA
# SPDX-License-Identifier: Apache-2.0

description:
  Texas Instruments BQ25120A Low IQ Highly Integrated
  Battery Charge Management Solution for Wearables and IoT

compatible: "ti,bq25120a"

include: i2c-device.yaml

properties:
  reg:
    required: true
```

## dts/bindings/regulator/ti,bq25120a-regulator.yaml
```yaml
# Copyright (c) 2024 Arduino SA
# SPDX -License-Identifier: Apache-2.0

description: |
  Texas Instruments BQ25120A Low IQ Highly Integrated
  Battery Charge Management Solution for Wearables and IoT

  This PMIC has one buck converter and one LDO converter. Both need to be
  defined as children nodes, strictly following the BUCK and LDO node
  names. For example:

  pmic@46 {
    compatible = "ti,bq25120a";
    reg = <0x46>;
    ...
    regulators {
      compatible = "ti,bq25120a-regulator";

      BUCK {
        /* all properties for BUCK */
      };
      LDO {
        /* all properties for LDO */
      };
    };
  };

compatible: "ti,bq25120a-regulator"

include: base.yaml

child-binding:
  include:
    - name: regulator.yaml
      property-allowlist:
        - regulator-always-on
        - regulator-boot-on
        - regulator-init-microvolt
        - regulator-min-microvolt
        - regulator-max-microvolt
```

## dts/bindings/sensor/bosch,bhy2-spi.yaml
```yaml
# Copyright (c) 2018, Bosch Sensortec GmbH
# SPDX-License-Identifier: Apache-2.0

description: |
  The BHI2xx family is a set of smart sensor hubs that integrate sensors and
  sensor fusion software, designed to offload the host processor from sensor
  management tasks.

compatible: "bosch,bhy2"

include: [sensor-device.yaml, spi-device.yaml]

properties:
  int-gpios:
    type: phandle-array
    description: |
      Identifies pin for the INT signal on the sensor.

child-binding:
  description: |
    Information on a BHI2xx sensor channel.
  properties:
    sensor-id:
      type: string
      required: true
      description: |
        The sensor name as defined in the BHY2 sensor hub framework,
        without the BHY2_SENSOR_ID_ prefix. For example, refer to the
        calibrated accelerometer data as "ACC".
    channel:
      type: string
      description: |
        The Zephyr sensor_channel enum identifier for the current channel,
        without the SENSOR_CHAN_ prefix. For example, refer to the
        accelelerometer vector as "ACCEL_XYZ".
        If not set, this channel will be associated with a private channel 
        with number SENSOR_CHAN_PRIV_START + its BHY2 index.
    scale-factor:
      type: string
      description: |
        Override the default channel-specific scale factor that is applied
        to the raw sensor data to obtain the sensor data in the desired unit.
    sampling-rate:
      type: int
      default: 0
      description: |
        The rate at which the sensor data is sampled, in Hz. If a rate lower
        than 1 Hz is desired, use the sampling-interval property instead.
        If neither is set, the sensor will be disabled.
    sampling-interval:
      type: int
      default: 0
      description: |
        The interval at which the sensor data is sampled, in seconds. If an
        interval smaller than 1 second is desired, use the sampling-rate
        property instead. If neither is set, the sensor will be disabled.
    sampling-latency-ms:
      type: int
      default: 0
      description: |
        The maximum delay between the time the sensor data is sampled and the
        time it is available to the host, in milliseconds. Setting a non-zero
        latency improves throughput by allowing the sensor hub to batch
        multiple samples before sending them to the host.
```

## subsys/llext/Kconfig
```kconfig
# Copyright (c) 2023 Intel Corporation
# SPDX-License-Identifier: Apache-2.0

menuconfig LLEXT
	bool "Linkable loadable extensions"
	select CACHE_MANAGEMENT if DCACHE
	help
	  Enable the linkable loadable extension subsystem

if LLEXT

choice LLEXT_BINARY_TYPE
	prompt "Binary object type for llext"
	default LLEXT_TYPE_ELF_OBJECT if ARM
	default LLEXT_TYPE_ELF_SHAREDLIB if XTENSA
	help
	  Object type for llext

config LLEXT_TYPE_ELF_OBJECT
	bool "Single object ELF file"
	help
	  Build and expect object files as binary object type for the
	  llext subsystem. A single compiler invocation is used to
	  generate the object file.

config LLEXT_TYPE_ELF_RELOCATABLE
	bool "Relocatable ELF file"
	help
	  Build and expect relocatable (partially linked )files as the
	  binary object type for the llext subsystem. These object files
	  are generated by the linker by combining multiple object files
	  into a single one.

config LLEXT_TYPE_ELF_SHAREDLIB
	bool "Shared library ELF file"
	help
	  Build and expect shared libraries as binary object type for
	  the llext subsystem. The usual linking process is used to
	  generate the shared library from multiple object files.

endchoice

config LLEXT_HEAP_SIZE
	int "llext heap memory size in kilobytes"
	default 8
	help
	  Heap size in kilobytes available to llext for dynamic allocation

config LLEXT_SHELL
	bool "llext shell commands"
	depends on SHELL
	help
	  Manage llext with shell commands for loading, unloading, and introspection

config LLEXT_SHELL_MAX_SIZE
	int "Maximum size of llext in bytes"
	depends on LLEXT_SHELL
	default 8192
	help
	  When loading llext with shell it is stored in a temporary buffer of this size

config LLEXT_STORAGE_WRITABLE
	bool "llext storage is writable"
	help
	  Select if LLEXT storage is writable, i.e. if extensions are stored in
	  RAM and can be modified in place

config LLEXT_EXPORT_BUILTINS_BY_SLID
	bool "export built-in symbols to llexts via SLIDs"
	help
	  When enabled, symbols exported from the Zephyr kernel
	  or application (via EXPORT_SYMBOL) are linked to LLEXTs
	  via Symbol Link Identifiers (SLIDs) instead of name.

	  Enabling this option provides a huge size reduction,
	  makes the linking process faster and provides more
	  confidentiality, as exported symbol names are dropped
	  from the binary. However, it can make LLEXT debugging
	  harder and prevents usage of 'llext_find_sym' to look
	  up symbols from the built-in table by name. It also
	  requires the LLEXTs to be post-processed after build.

module = LLEXT
module-str = llext
source "subsys/logging/Kconfig.template.log_config"

endif
```

## subsys/modules/Kconfig
```kconfig
# Copyright (c) 2022 Intel Corporation
# SPDX-License-Identifier: Apache-2.0

menuconfig MODULES
	bool "Dynamic module loading"
	depends on !EXECUTE_XOR_WRITE
	help
	  Enable dynamic module loading

if MODULES

config MODULES_CODE_SIZE
	int "Module code memory size"
	default 131072
	help
	  Memory reserved for dynamic module code, in bytes

config MODULES_DATA_SIZE
	int "Module data memory size"
	default 131072
	help
	  Memory reserved for dynamic module data and relocations, in bytes

config MODULES_STACK_SIZE
	int "Module execution stack size"
	default 8192
	help
	  Memory reserved for module thread stack, in bytes

config MODULES_INIT_PRIORITY
	int "Module subsystem init priority"
	default 50
	help
	  Modules subsystem init priority at POST_KERNEL level

config MODULES_SHELL
	bool "Modules shell commands"
    depends on SHELL
	help
	  Manage modules with shell commands

module = MODULES
module-str = modules
source "subsys/logging/Kconfig.template.log_config"

endif
```
